## meta-brickyard/conf/layer.conf
```bitbake
BBPATH =. "${LAYERDIR}:"

BBFILES += "${LAYERDIR}/recipes-*/*/*.bb \
            ${LAYERDIR}/recipes-*/*/*.bbappend"

BBFILE_COLLECTIONS += "brickyard"
BBFILE_PATTERN_brickyard = "^${LAYERDIR}/"
BBFILE_PRIORITY_brickyard = "10"

LAYERVERSION_brickyard = "1"
LAYERDEPENDS_brickyard = "core"
LAYERSERIES_COMPAT_brickyard = "zeus"
```
